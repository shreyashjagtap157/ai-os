## build/configs/aios_arm64_defconfig
```kconfig
################################################################################
#
# AI-OS for Generic ARM64 Devices
#
################################################################################

# Architecture
BR2_aarch64=y
BR2_cortex_a53=y

# Toolchain
BR2_TOOLCHAIN_EXTERNAL=y
BR2_TOOLCHAIN_EXTERNAL_DOWNLOAD=y

# Kernel
BR2_LINUX_KERNEL=y
BR2_LINUX_KERNEL_CUSTOM_VERSION=y
BR2_LINUX_KERNEL_CUSTOM_VERSION_VALUE="6.6"
BR2_LINUX_KERNEL_DEFCONFIG="defconfig"
BR2_LINUX_KERNEL_DTS_SUPPORT=y
BR2_LINUX_KERNEL_INSTALL_TARGET=y

# Bootloader (U-Boot generic)
BR2_TARGET_UBOOT=y
BR2_TARGET_UBOOT_BUILD_SYSTEM_KCONFIG=y
BR2_TARGET_UBOOT_CUSTOM_VERSION=y
BR2_TARGET_UBOOT_CUSTOM_VERSION_VALUE="2023.10"
BR2_TARGET_UBOOT_BOARD_DEFCONFIG="qemu_arm64"

# Filesystem
BR2_TARGET_ROOTFS_EXT2=y
BR2_TARGET_ROOTFS_EXT2_4=y
BR2_TARGET_ROOTFS_EXT2_SIZE="2G"

# Init system
BR2_INIT_SYSTEMD=y

# Core packages
BR2_PACKAGE_BASH=y
BR2_PACKAGE_COREUTILS=y
BR2_PACKAGE_OPENSSH=y

# Networking
BR2_PACKAGE_DHCPCD=y
BR2_PACKAGE_WPA_SUPPLICANT=y

# Graphics
BR2_PACKAGE_WAYLAND=y
BR2_PACKAGE_WESTON=y
BR2_PACKAGE_MESA3D=y
BR2_PACKAGE_MESA3D_GALLIUM_DRIVER_SWRAST=y

# Python
BR2_PACKAGE_PYTHON3=y
BR2_PACKAGE_PYTHON3_PIP=y

# AI-OS packages
BR2_PACKAGE_AIOS_CORE=y
BR2_PACKAGE_AIOS_AGENT=y
BR2_PACKAGE_AIOS_VOICE=y
BR2_PACKAGE_AIOS_UI=y
```

## build/configs/aios_defconfig
```kconfig
################################################################################
#
# AI-OS Root Filesystem Configuration
# Based on Buildroot for building custom Linux distribution
#
################################################################################

# Architecture (x86_64 for PC, aarch64 for ARM devices)
BR2_x86_64=y
BR2_TOOLCHAIN_EXTERNAL=y
BR2_TOOLCHAIN_EXTERNAL_DOWNLOAD=y

# Kernel
BR2_LINUX_KERNEL=y
BR2_LINUX_KERNEL_CUSTOM_VERSION=y
BR2_LINUX_KERNEL_CUSTOM_VERSION_VALUE="6.6"
BR2_LINUX_KERNEL_USE_CUSTOM_CONFIG=y
BR2_LINUX_KERNEL_CUSTOM_CONFIG_FILE="$(BR2_EXTERNAL_AIOS_PATH)/board/aios/linux-config"
BR2_LINUX_KERNEL_INSTALL_TARGET=y

# Bootloader
BR2_TARGET_GRUB2=y
BR2_TARGET_GRUB2_X86_64_EFI=y

# Init system
BR2_INIT_SYSTEMD=y
BR2_PACKAGE_SYSTEMD_FIRSTBOOT=y
BR2_PACKAGE_SYSTEMD_HOSTNAMED=y
BR2_PACKAGE_SYSTEMD_NETWORKD=y
BR2_PACKAGE_SYSTEMD_RESOLVED=y
BR2_PACKAGE_SYSTEMD_TIMESYNCD=y

# Filesystem
BR2_TARGET_ROOTFS_EXT2=y
BR2_TARGET_ROOTFS_EXT2_4=y
BR2_TARGET_ROOTFS_EXT2_SIZE="4G"

# Core utilities
BR2_PACKAGE_BUSYBOX=y
BR2_PACKAGE_BASH=y
BR2_PACKAGE_COREUTILS=y
BR2_PACKAGE_UTIL_LINUX=y
BR2_PACKAGE_PROCPS_NG=y
BR2_PACKAGE_HTOP=y
BR2_PACKAGE_NANO=y
BR2_PACKAGE_LESS=y

# Networking
BR2_PACKAGE_DHCPCD=y
BR2_PACKAGE_OPENSSH=y
BR2_PACKAGE_CURL=y
BR2_PACKAGE_WGET=y
BR2_PACKAGE_IPTABLES=y

# Audio
BR2_PACKAGE_ALSA_UTILS=y
BR2_PACKAGE_PULSEAUDIO=y

# Graphics (Wayland-based)
BR2_PACKAGE_WAYLAND=y
BR2_PACKAGE_WAYLAND_PROTOCOLS=y
BR2_PACKAGE_WESTON=y
BR2_PACKAGE_MESA3D=y
BR2_PACKAGE_MESA3D_GALLIUM_DRIVER_SWRAST=y
BR2_PACKAGE_MESA3D_OPENGL_EGL=y
BR2_PACKAGE_MESA3D_OPENGL_ES=y
BR2_PACKAGE_LIBDRM=y

# Input
BR2_PACKAGE_LIBINPUT=y
BR2_PACKAGE_EVTEST=y

# Python for AI agent
BR2_PACKAGE_PYTHON3=y
BR2_PACKAGE_PYTHON3_PIP=y
BR2_PACKAGE_PYTHON3_SSL=y
BR2_PACKAGE_PYTHON_REQUESTS=y

# Speech recognition dependencies
BR2_PACKAGE_PORTAUDIO=y
BR2_PACKAGE_FLAC=y
BR2_PACKAGE_ESPEAK=y

# Hardware support
BR2_PACKAGE_V4L2_UTILS=y
BR2_PACKAGE_BLUEZ5_UTILS=y
BR2_PACKAGE_BLUEZ5_UTILS_OBEX=y
BR2_PACKAGE_WPA_SUPPLICANT=y

# Development
BR2_PACKAGE_GDB=y
BR2_PACKAGE_STRACE=y

# Custom AI-OS packages
BR2_PACKAGE_AIOS_AGENT=y
BR2_PACKAGE_AIOS_UI=y
BR2_PACKAGE_AIOS_VOICE=y
BR2_PACKAGE_AIOS_CORE=y
```

## build/configs/aios_rpi4_defconfig
```kconfig
################################################################################
#
# AI-OS for Raspberry Pi 4
#
################################################################################

# Architecture
BR2_aarch64=y
BR2_cortex_a72=y

# Toolchain
BR2_TOOLCHAIN_EXTERNAL=y
BR2_TOOLCHAIN_EXTERNAL_DOWNLOAD=y

# Kernel
BR2_LINUX_KERNEL=y
BR2_LINUX_KERNEL_CUSTOM_TARBALL=y
BR2_LINUX_KERNEL_CUSTOM_TARBALL_LOCATION="https://github.com/raspberrypi/linux/archive/rpi-6.1.y.tar.gz"
BR2_LINUX_KERNEL_DEFCONFIG="bcm2711"
BR2_LINUX_KERNEL_DTS_SUPPORT=y
BR2_LINUX_KERNEL_INTREE_DTS_NAME="broadcom/bcm2711-rpi-4-b"
BR2_LINUX_KERNEL_NEEDS_HOST_OPENSSL=y

# Bootloader
BR2_PACKAGE_RPI_FIRMWARE=y
BR2_PACKAGE_RPI_FIRMWARE_VARIANT_PI4=y

# Filesystem
BR2_TARGET_ROOTFS_EXT2=y
BR2_TARGET_ROOTFS_EXT2_4=y
BR2_TARGET_ROOTFS_EXT2_SIZE="2G"

# Create SD card image
BR2_ROOTFS_POST_IMAGE_SCRIPT="$(BR2_EXTERNAL_AIOS_EXTERNAL_PATH)/board/raspberrypi4/post-image.sh"

# Init system
BR2_INIT_SYSTEMD=y

# Core packages (same as base)
BR2_PACKAGE_BASH=y
BR2_PACKAGE_COREUTILS=y
BR2_PACKAGE_OPENSSH=y

# WiFi/Bluetooth for RPi
BR2_PACKAGE_WPA_SUPPLICANT=y
BR2_PACKAGE_BLUEZ5_UTILS=y
BR2_PACKAGE_LINUX_FIRMWARE=y
BR2_PACKAGE_LINUX_FIRMWARE_BRCM_BCM43XXX=y

# Graphics
BR2_PACKAGE_WAYLAND=y
BR2_PACKAGE_WESTON=y
BR2_PACKAGE_MESA3D=y
BR2_PACKAGE_MESA3D_GALLIUM_DRIVER_VC4=y
BR2_PACKAGE_MESA3D_GALLIUM_DRIVER_V3D=y

# Audio
BR2_PACKAGE_ALSA_UTILS=y
BR2_PACKAGE_PULSEAUDIO=y

# Python
BR2_PACKAGE_PYTHON3=y
BR2_PACKAGE_PYTHON3_PIP=y

# AI-OS packages
BR2_PACKAGE_AIOS_CORE=y
BR2_PACKAGE_AIOS_AGENT=y
BR2_PACKAGE_AIOS_VOICE=y
BR2_PACKAGE_AIOS_UI=y
```

## build/configs/aios_x86_64_defconfig
```kconfig
################################################################################
#
# AI-OS for x86_64 PC
#
################################################################################

# Include base configuration
include $(BR2_EXTERNAL_AIOS_EXTERNAL_PATH)/configs/aios_defconfig

# x86_64 specific
BR2_x86_64=y
BR2_x86_corei7=y
```

## build/external/Config.in
```kconfig
source "$BR2_EXTERNAL_AIOS_EXTERNAL_PATH/package/aios-core/Config.in"
source "$BR2_EXTERNAL_AIOS_EXTERNAL_PATH/package/aios-agent/Config.in"
source "$BR2_EXTERNAL_AIOS_EXTERNAL_PATH/package/aios-ui/Config.in"
source "$BR2_EXTERNAL_AIOS_EXTERNAL_PATH/package/aios-voice/Config.in"
```

## build/external/package/aios-agent/Config.in
```kconfig
config BR2_PACKAGE_AIOS_AGENT
	bool "aios-agent"
	depends on BR2_PACKAGE_PYTHON3
	depends on BR2_PACKAGE_AIOS_CORE
	select BR2_PACKAGE_PYTHON_REQUESTS
	help
	  AI-OS Agent daemon with LLM integration.
```

## build/external/package/aios-core/Config.in
```kconfig
config BR2_PACKAGE_AIOS_CORE
	bool "aios-core"
	depends on BR2_PACKAGE_PYTHON3
	help
	  AI-OS Core components including HAL and system utilities.
```

## build/external/package/aios-ui/Config.in
```kconfig
config BR2_PACKAGE_AIOS_UI
	bool "aios-ui"
	depends on BR2_PACKAGE_PYTHON3
	depends on BR2_PACKAGE_AIOS_AGENT
	depends on BR2_PACKAGE_WESTON
	help
	  AI-OS Wayland-based user interface.
```

## build/external/package/aios-voice/Config.in
```kconfig
config BR2_PACKAGE_AIOS_VOICE
	bool "aios-voice"
	depends on BR2_PACKAGE_PYTHON3
	depends on BR2_PACKAGE_AIOS_AGENT
	select BR2_PACKAGE_PORTAUDIO
	select BR2_PACKAGE_ESPEAK
	help
	  AI-OS Voice recognition and TTS service.
```
